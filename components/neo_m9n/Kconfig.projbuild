## components/neo_m9n/Kconfig.projbuild
```kconfig
menu "Neo-M9N GPS"

    config NEO_M9N_ENABLE
        bool "Enable Neo-M9N GPS driver"
        default n
        help
            Start the u-blox NEO-M9N-00B GPS driver (UART, NMEA-0183) from app_main.
            The driver parses GGA/GSA/GSV/RMC/GLL/VTG statements and emits GPS_UPDATE
            events on its own event loop.

    config NEO_M9N_BAUD_RATE
        int "GPS UART baud rate"
        range 1200 230400
        default 9600
        help
            Baud rate of the UART interface to the GPS module. 9600 is the classic
            NMEA default; newer u-blox M9 firmware defaults UART1 to 38400. Match
            this setting to the module configuration (e.g. set via u-center or the
            UBX-CFG-PRT command).

    config NMEA_PARSER_UART_RXD
        int "GPS UART RX pin number"
        range 0 64
        default 5
        help
            GPIO number for the UART RX pin connected to the GPS TX pin.

    config NMEA_PARSER_RING_BUFFER_SIZE
        int "NMEA Parser Ring Buffer Size"
        range 0 2048
        default 1024
        help
            Size of the ring buffer used for the UART Rx channel.

    config NMEA_PARSER_TASK_STACK_SIZE
        int "NMEA Parser Task Stack Size"
        range 0 4096
        default 3072
        help
            Stack size of the NMEA parser task.

    config NMEA_PARSER_TASK_PRIORITY
        int "NMEA Parser Task Priority"
        range 0 24
        default 2
        help
            Priority of the NMEA parser task.

    menu "NMEA Statement Support"
        comment "At least one statement must be selected"

        config NMEA_STATEMENT_GGA
            bool "GGA Statement"
            default y
            help
                Parse latitude, longitude, altitude, number of satellites in use,
                fix status (no fix, GPS, DGPS) and UTC time from GGA.

        config NMEA_STATEMENT_GSA
            bool "GSA Statement"
            default y
            help
                Parse position/vertical/horizontal dilution of precision, fix mode
                (no fix, 2D, 3D) and IDs of satellites in use from GSA.

        config NMEA_STATEMENT_GSV
            bool "GSV Statement"
            default y
            help
                Parse number of satellites in view and details of each satellite
                in view from GSV.

        config NMEA_STATEMENT_RMC
            bool "RMC Statement"
            default y
            help
                Parse GPS signal validity, ground speed (knots), course over ground
                (degrees), magnetic variation and UTC date from RMC.

        config NMEA_STATEMENT_GLL
            bool "GLL Statement"
            default y
            help
                Parse latitude, longitude and UTC time from GLL.

        config NMEA_STATEMENT_VTG
            bool "VTG Statement"
            default y
            help
                Parse ground speed (knots, km/h) and course over ground (degrees)
                from VTG.

    endmenu

endmenu
```

## main/Kconfig.projbuild
```kconfig
menu "Example Configuration"

    config EXAMPLE_BASIC_AUTH
        bool "Basic Authentication"
        default n
        help
            Basic Authentication is a method for an HTTP user agent (e.g. a web browser)
            to provide a user name and password when making a request. It is the simplest
            technique for enforcing access controls to web resources. because it doesn't
            require cookies, session identifiers, or login pages; rather, it uses standard
            fields in the HTTP header.
            Note that, Basic Authentication is not encrypted channel and also easy to retrieve
            credentials as they are sent in plain text format.

    config EXAMPLE_BASIC_AUTH_USERNAME
        string "Basic Authenticate User Name"
        depends on EXAMPLE_BASIC_AUTH
        default "ESP32"
        help
            The client's user name which used for basic authenticate.

    config EXAMPLE_BASIC_AUTH_PASSWORD
        string "Basic Authenticate Password"
        depends on EXAMPLE_BASIC_AUTH
        default "ESP32Webserver"
        help
            The client's password which used for basic authenticate.

    config EXAMPLE_ENABLE_SSE_HANDLER
        bool "Enable Server-Sent Events (SSE) handler"
        default n
        help
            Enable this option to use Server-Sent Events (SSE) functionality.
            This will allow the server to push real-time updates to the client over an HTTP connection.

endmenu

menu "Vigilant Engine Configuration: LEDs"
    config VE_ENABLE_STATUS_LED
        bool "Enable Status LED"
        default y
        help
            Enable this option to use the status LED functionality in Vigilant Engine.
            The status LED provides visual feedback on the system's status and operations, and can optionally be used for visual output.

    choice VE_LED_TYPE
        prompt "LED Type"
        default VE_LED_TYPE_GENERIC
        depends on VE_ENABLE_STATUS_LED
        help
            Select the type of LED functionality to enable in Vigilant Engine.

        config VE_LED_TYPE_WS2812B
            bool "WS2812B LED"

        config VE_LED_TYPE_GENERIC
            bool "Generic LED"
    endchoice

    config VE_STATUS_WS2812B_PIN
        int "WS2812B Data Pin"
        default 8
        depends on VE_LED_TYPE_WS2812B

    config VE_INVERT_STATUS_LED
        bool "Invert Status LED GPIO"
        default y
        help
            Enable this option to invert the signals sent to the status led. On some boards (e.g S3) LOW means the led turns on.
            On other boards LOW might turn them off. Not particularly relevant, as it is mostly blinking anyways.

    choice VE_STATUS_LED_MODE
        prompt "LED Operation Mode"
        default VE_STATUS_LED_MODE_RGB
        depends on VE_LED_TYPE_GENERIC
        help
            Select how the LED conveys status information.

        config VE_STATUS_LED_MODE_RGB
            bool "RGB (Color-based)"

        config VE_STATUS_LED_MODE_BLINK
            bool "BLINK (Frequency-based)"
    endchoice

    config VE_STATUS_LED_GPIO_RED
        int "Red LED GPIO"
        range 0 64
        default 46
        depends on VE_STATUS_LED_MODE_RGB

    config VE_STATUS_LED_GPIO_GREEN
        int "Green LED GPIO"
        range 0 64
        default 0
        depends on VE_STATUS_LED_MODE_RGB

    config VE_STATUS_LED_GPIO_BLUE
        int "Blue LED GPIO"
        range 0 64
        default 45
        depends on VE_STATUS_LED_MODE_RGB

    config VE_STATUS_LED_GPIO_BLINK
        int "Blink LED GPIO"
        range 0 64
        default 48
        depends on VE_STATUS_LED_MODE_BLINK
endmenu

menu "APOGEE GPS (u-blox NEO-M9N)"
    config GPS_ENABLE
        bool "Enable GPS"
        default y
        help
            Enable the NEO-M9N UART receiver and NMEA parser task.

    config GPS_UART_PORT
        int "GPS UART port"
        range 0 2
        default 1
        depends on GPS_ENABLE
        help
            Hardware UART used for the GPS. UART0 is commonly reserved for the
            console, so UART1 is the recommended default.

    config GPS_UART_RX_GPIO
        int "ESP RX GPIO (connected to GPS TX)"
        range 0 64
        default 47
        depends on GPS_ENABLE

    config GPS_UART_TX_GPIO
        int "ESP TX GPIO (connected to GPS RX)"
        range 0 64
        default 48
        depends on GPS_ENABLE

    config GPS_UART_BAUD_RATE
        int "GPS UART baud rate"
        range 4800 921600
        default 38400
        depends on GPS_ENABLE
        help
            The NEO-M9N-00B factory default is 38400 baud, 8 data bits, no
            parity, and one stop bit.

    config GPS_LOG_FIXES
        bool "Periodically log GPS fixes"
        default y
        depends on GPS_ENABLE
        help
            Log fix state changes and a position summary every ten seconds.

    config GPS_LOG_DIAGNOSTICS
        bool "Periodically log satellite signal diagnostics"
        default y
        depends on GPS_ENABLE
        help
            Log GSV carrier-to-noise information for each GNSS and signal every
            ten seconds, plus changes between no-fix, 2D, and 3D navigation.
endmenu

menu "Vigilant Engine Configuration: WiFi"
    # --- Wifi Settings ---
    config VE_STA_SSID
        string "WiFi STA SSID"
        default "starstreak"
        help
            The SSID of the WiFi network the Vigilant Engine should connect to.
    config VE_STA_PASSWORD
        string "WiFi STA Password"
        default "starstreak"
        help
            The password for the WiFi network the Vigilant Engine should connect to.
    config VE_STA_RECONNECT_INTERVAL_MS
        int "WiFi STA Reconnect Interval (ms)"
        default 3000
        help
            The interval in milliseconds for attempting to reconnect to the WiFi network when the connection is lost in STA mode.
    config VE_AP_SSID_PREFIX
        string "WiFi AP SSID Prefix"
        default "starstreak-"
        help
            The prefix for the SSID of the WiFi Access Point (AP) mode of the Vigilant Engine. The full SSID will be generated by appending the device's MAC address to this prefix.
    config VE_AP_PASSWORD
        string "WiFi AP Password"
        default "starstreak"
        help
            The password for the WiFi Access Point (AP) mode of the Vigilant Engine.
endmenu

menu "Vigilant Engine Configuration: I2C"
    config VE_ENABLE_I2C
        bool "Enable I2C"
        default n
        help
            Enable this option to use I2C functionality in Vigilant Engine.

    config VE_I2C_SCL_IO
        int "I2C SCL GPIO"
        range 0 64
        default 0
        depends on VE_ENABLE_I2C
        help
            The GPIO pin for the I2C SCL signal.

    config VE_I2C_SDA_IO
        int "I2C SDA GPIO"
        range 0 64
        default 1
        depends on VE_ENABLE_I2C
        help
            The GPIO pin for the I2C SDA signal.

    config VE_I2C_FREQ_HZ
        int "I2C Frequency (Hz)"
        default 100000
        depends on VE_ENABLE_I2C
        help
            The frequency of the I2C communication in Hertz. Common values are 100000 (100 kHz) for standard mode and 400000 (400 kHz) for fast mode.
endmenu
```
